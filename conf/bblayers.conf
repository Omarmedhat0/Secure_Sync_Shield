## conf/bblayers.conf
```bitbake
# POKY_BBLAYERS_CONF_VERSION is increased each time build/conf/bblayers.conf
# changes incompatibly
POKY_BBLAYERS_CONF_VERSION = "2"

BBPATH = "${TOPDIR}"
BBFILES ?= ""
BBLAYERS ?= " \
  /home/omar/ITI/yocto/poky/meta \
  /home/omar/ITI/yocto/poky/meta-poky \
  /home/omar/ITI/yocto/poky/meta-yocto-bsp \
  /home/omar/ITI/yocto/poky/meta-raspberrypi \
  /home/omar/ITI/yocto/poky/meta-secure-sync-shield \
  /home/omar/ITI/yocto/poky/meta-openembedded/meta-oe \
  /home/omar/ITI/yocto/poky/meta-openembedded/meta-python \
  /home/omar/ITI/yocto/poky/meta-openembedded/meta-networking \
  /home/omar/ITI/yocto/poky/meta-openembedded/meta-multimedia \
  /home/omar/ITI/yocto/poky/build/workspace \
  /home/omar/ITI/yocto/poky/meta-qt5 \
  "
```

## meta-secure-sync-shield/conf/layer.conf
```bitbake
# Specify the compatible Yocto release(s)
LAYERSERIES_COMPAT_secure-sync-shield = "kirkstone"

# We have a conf and classes directory, add to BBPATH
BBPATH .= ":${LAYERDIR}"

# We have recipes-* directories, add to BBFILES
BBFILES += "${LAYERDIR}/recipes-*/*/*.bb \
            ${LAYERDIR}/recipes-*/*/*.bbappend"

# Add the configuration directory to BBFILES
BBFILES += "${LAYERDIR}/conf/*"

BBFILE_COLLECTIONS += "secure-sync-shield"
BBFILE_PATTERN_secure-sync-shield := "^${LAYERDIR}/"
BBFILE_PRIORITY_secure-sync-shield = "6"
```
